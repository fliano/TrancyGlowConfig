#include "trancyglow.dtsi" // Notice that the main dtsi files are included in the overlay.
#include "trancyglow_central_trackpad.dtsi"

&kscan0 {
    col-gpios
      = <&pro_micro 9 ( GPIO_ACTIVE_HIGH | GPIO_PULL_DOWN )> // col1 in the schematic
      , <&pro_micro 8 ( GPIO_ACTIVE_HIGH | GPIO_PULL_DOWN )> // col2 in the schematic
      , <&pro_micro 7 ( GPIO_ACTIVE_HIGH | GPIO_PULL_DOWN )> // col3 in the schematic
      , <&pro_micro 6 ( GPIO_ACTIVE_HIGH | GPIO_PULL_DOWN )> // col4 in the schematic
      , <&pro_micro 5 ( GPIO_ACTIVE_HIGH | GPIO_PULL_DOWN )> // col5 in the schematic
    ;
    row-gpios
      = <&pro_micro 15 (GPIO_ACTIVE_HIGH)> // Row 1 from the schematic file
        , <&pro_micro 14 (GPIO_ACTIVE_HIGH)> // Row 2 from the schematic file
        , <&pro_micro 16 (GPIO_ACTIVE_HIGH)> // Row 3 from the schematic file
        , <&pro_micro 10 (GPIO_ACTIVE_HIGH)> // Row 4 from the schematic file
    ;
};

&trackball_listener {
    status = "okay";
};