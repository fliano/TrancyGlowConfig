## config/boards/shields/trancyglow/Kconfig.defconfig
```kconfig
if TrancyGlow_RIGHT

config ZMK_SPLIT_ROLE_CENTRAL
    default y

endif
 

if TrancyGlow_LEFT || TrancyGlow_RIGHT

config ZMK_KEYBOARD_NAME
    default "TrancyGlow"

config ZMK_SLEEP
	default y

config ZMK_SPLIT
    default y

config ZMK_BLE
  default y

endif 
```

## config/boards/shields/trancyglow_dongle/Kconfig.shield
```kconfig
config SHIELD_TRANCYGLOW_DONGLE
  def_bool $(shields_list_contains,trancyglow_dongle)
```

## config/west.yml
```yaml
manifest:
  remotes:
    - name: zmkfirmware
      url-base: https://github.com/fliano
    - name: pmw3610
      url-base: https://github.com/badjeff
  projects:
    - name: zmk
      remote: zmkfirmware
      revision: underglow-status-current-zmk-master
      import: app/west.yml
    - name: zmk-pmw3610-driver
      remote: pmw3610
      revision: zmk-0.3
  self:
    path: config
```
