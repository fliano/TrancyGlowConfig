## config/boards/shields/trancyglow/Kconfig.shield
```kconfig
config TrancyGlow_LEFT
    def_bool $(shields_list_contains,trancyglow_left)

config TrancyGlow_RIGHT
    def_bool $(shields_list_contains,trancyglow_right)
```
