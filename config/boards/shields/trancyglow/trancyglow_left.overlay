#include "trancyglow.dtsi"

&kscan0 {
    col-gpios
      = <&pro_micro 18 ( GPIO_ACTIVE_HIGH | GPIO_PULL_DOWN )> // col1 in the schematic
      , <&pro_micro 15 ( GPIO_ACTIVE_HIGH | GPIO_PULL_DOWN )> // col2 in the schematic
      , <&pro_micro 14 ( GPIO_ACTIVE_HIGH | GPIO_PULL_DOWN )> // col3 in the schematic
      , <&pro_micro 16 ( GPIO_ACTIVE_HIGH | GPIO_PULL_DOWN )> // col4 in the schematic
      , <&pro_micro 10 ( GPIO_ACTIVE_HIGH | GPIO_PULL_DOWN )> // col5 in the schematic
    ;
    row-gpios
      = <&pro_micro 6 (GPIO_ACTIVE_HIGH)> // Row 1 from the schematic file
        , <&pro_micro 7 (GPIO_ACTIVE_HIGH)> // Row 2 from the schematic file
        , <&pro_micro 8 (GPIO_ACTIVE_HIGH)> // Row 3 from the schematic file
        , <&pro_micro 9 (GPIO_ACTIVE_HIGH)> // Row 4 from the schematic file
    ;
};

&pro_micro_i2c {
  status = "okay";
  tps43: iqs5xx@74 {
    status = "okay";
    compatible = "azoteq,iqs5xx";
    reg = <0x74>;

    reset-gpios = <&gpio0 17 GPIO_ACTIVE_LOW>; // TODO pin
    rdy-gpios = <&gpio0 20 GPIO_ACTIVE_HIGH>; // TODO pin
    /*
         * Potentially non-exhaustive list of configuration options.
         * See: dts/bindings/input/azoteq,iqs5xx-common.yaml for a full list.
    */
    one-finger-tap;
    press-and-hold;
    press-and-hold-time = <250>;
    two-finger-tap;

    scroll;
    natural-scroll-y;
    natural-scroll-x;

    bottom-beta = <5>;
    stationary-threshold = <5>;

    switch-xy;
  };
};

&trackball_split {
    device = <&tps43>;
};